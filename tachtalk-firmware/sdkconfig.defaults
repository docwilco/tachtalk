## tachtalk-firmware/sdkconfig.defaults
```kconfig
# Rust often needs a bit of an extra main task stack size compared to C (the default is 3K)
CONFIG_ESP_MAIN_TASK_STACK_SIZE=16384

# Default pthread stack size (default is 3072, Rust needs more)
CONFIG_PTHREAD_TASK_STACK_SIZE_DEFAULT=16384

# Use this to set FreeRTOS kernel tick frequency to 1000 Hz (100 Hz by default).
# This allows to use 1 ms granuality for thread sleeps (10 ms by default).
CONFIG_FREERTOS_HZ=1000

# Workaround for https://github.com/espressif/esp-idf/issues/7631
CONFIG_MBEDTLS_CERTIFICATE_BUNDLE=n
CONFIG_MBEDTLS_CERTIFICATE_BUNDLE_DEFAULT_FULL=n

# Set compile-time max log level to DEBUG, runtime default to INFO
CONFIG_LOG_MAXIMUM_LEVEL_DEBUG=n
CONFIG_LOG_DEFAULT_LEVEL_INFO=y

# Increase HTTP server header buffer for captive portal (mobile browsers send long headers)
CONFIG_HTTPD_MAX_REQ_HDR_LEN=4096

# Enable mDNS for tachtalk.local access
CONFIG_MDNS_ENABLED=y

# Increase max sockets for handling multiple concurrent connections
# Default is 10, max is 16 per LWIP Kconfig
CONFIG_LWIP_MAX_SOCKETS=16

# Task watchdog timeout (default 5s, increased for slow WiFi operations)
CONFIG_ESP_TASK_WDT_TIMEOUT_S=15
```

## tachtalk-test-firmware/sdkconfig.defaults
```kconfig
# N16R8 has 16MB flash
CONFIG_ESPTOOLPY_FLASHSIZE_16MB=y

# Custom OTA partition table: two 3MB OTA slots, no factory partition.
# Path is resolved relative to the workspace directory (crate root).
CONFIG_PARTITION_TABLE_CUSTOM=y
CONFIG_PARTITION_TABLE_CUSTOM_FILENAME="partitions.csv"

# Enable OTA rollback: new firmware must call mark_running_slot_valid()
# or the bootloader reverts to the previous image on next reset.
CONFIG_BOOTLOADER_APP_ROLLBACK_ENABLE=y

# Rust often needs a bit of an extra main task stack size compared to C (the default is 3K)
CONFIG_ESP_MAIN_TASK_STACK_SIZE=16384

# Default pthread stack size (default is 3072, Rust needs more)
CONFIG_PTHREAD_TASK_STACK_SIZE_DEFAULT=16384

# Use this to set FreeRTOS kernel tick frequency to 1000 Hz (100 Hz by default).
# This allows to use 1 ms granuality for thread sleeps (10 ms by default).
CONFIG_FREERTOS_HZ=1000

# TLS certificate bundle for HTTPS client (OTA downloads from GitHub)
CONFIG_MBEDTLS_CERTIFICATE_BUNDLE=y
CONFIG_MBEDTLS_CERTIFICATE_BUNDLE_DEFAULT_FULL=y

# Set compile-time max log level to DEBUG, runtime default to INFO
CONFIG_LOG_MAXIMUM_LEVEL_DEBUG=y
CONFIG_LOG_DEFAULT_LEVEL_INFO=y

# Increase HTTP server header buffer for captive portal (mobile browsers send long headers)
CONFIG_HTTPD_MAX_REQ_HDR_LEN=4096

# Enable mDNS for tachtalk.local access
CONFIG_MDNS_ENABLED=y

# Increase max sockets for handling multiple concurrent connections
# Default is 10, max is 16 per LWIP Kconfig
CONFIG_LWIP_MAX_SOCKETS=16

# Task watchdog timeout (default 5s, increased for slow WiFi operations)
CONFIG_ESP_TASK_WDT_TIMEOUT_S=15

# Enable FreeRTOS runtime stats for CPU usage monitoring
CONFIG_FREERTOS_GENERATE_RUN_TIME_STATS=y
CONFIG_FREERTOS_USE_TRACE_FACILITY=y

# Enable pthread to use thread name for FreeRTOS task name
CONFIG_PTHREAD_TASK_NAME_DEFAULT=""

# Enable PSRAM for capture buffer (N16R8 variant has 8MB octal PSRAM)
CONFIG_SPIRAM=y
CONFIG_SPIRAM_MODE_OCT=y
CONFIG_SPIRAM_SPEED_80M=y
# Allow malloc to use PSRAM for large allocations
CONFIG_SPIRAM_USE_MALLOC=y
CONFIG_SPIRAM_MALLOC_ALWAYSINTERNAL=4096
```
